// Copyright 2024 Manna Harbour
// https://github.com/manna-harbour/miryoku

#include "miryoku/custom_config.h"
#include "miryoku/mapping/36/minidox.h"
#include "miryoku/custom_behaviors.dtsi"
#include "miryoku/miryoku.dtsi"

// nice!view display tweaks — DESACTIVADOS (firmware probado a 1 MHz, el
// default de ZMK, sin problemas). El adapter ya desactiva pro_micro_i2c.
// Si aparecen glitches por EMI en la mitad izquierda, descomenta:
//
// &pro_micro_i2c {
//     status = "disabled";
// };
//
// &nice_view {
//     spi-max-frequency = <100000>;
// };
